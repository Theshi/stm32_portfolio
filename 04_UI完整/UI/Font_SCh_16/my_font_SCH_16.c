/*
*---------------------------------------------------------------
*                        Lvgl Font Tool                         
*                                                               
* 注:使用unicode编码                                              
* 注:本字体文件由Lvgl Font Tool V0.5测试版 生成                     
* 作者:阿里(qq:617622104)                                         
*---------------------------------------------------------------
*/


#include "lvgl.h"
#include "W25Q64.h"
#include <string.h>


static const uint8_t glyph_bitmap[] = {
/* 兰 */
0x00,0x00,0x3b,0xfe,0x40,0x00,0x00,0x00,0x7d,0xfd,0x70,0x00,0x00,  //....*%@#*.......*#@#*....
0x00,0x08,0xd4,0x03,0xe2,0x00,0x00,0x07,0xa1,0x01,0xa9,0x00,0x00,  //...%#*.*#+.....*%+.+%%...
0x00,0x2d,0x00,0x00,0x3c,0x00,0x00,0x0e,0x00,0x00,0x0f,0x00,0x00,  //..+#....*#.....#.....@...
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0x0a,0xff,0xff,0xff,0xff,0xff,0xff,0xff,0xff,0xff,0xff,0xfa,0x00,  //.%@@@@@@@@@@@@@@@@@@@@@%.


/* 安 */
0x00,0x00,0x00,0x00,0x04,0xaf,0xff,0xd5,0x00,0x00,0x00,0x00,0x00,  //.........*%@@@#*.........
0x00,0x00,0x00,0x00,0x4e,0x50,0x00,0x3e,0x10,0x00,0x00,0x00,0x00,  //........*#*...*#+........
0x00,0x00,0x00,0x00,0xb4,0x00,0x00,0x09,0x60,0x00,0x00,0x00,0x00,  //........%*.....%*........
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0x00,0x9e,0xff,0xeb,0x86,0x20,0x00,0x00,0x00,0x04,0xae,0xd4,0x00,  //..%#@@#%%*+........*%##*.


/* 州 */
0x00,0x02,0xaf,0xff,0xe9,0x18,0xef,0xfd,0x70,0x7d,0xff,0xe9,0x00,  //...+%@@@#%+%#@@#*.*#@@#%.
0x00,0x0b,0x91,0x00,0x19,0xfb,0x10,0x02,0xcd,0xc2,0x00,0x19,0xa0,  //...%%+..+%@%+..+###+..+%%
0x00,0x0f,0x00,0x00,0x02,0xf1,0x00,0x00,0x1f,0x10,0x00,0x00,0xf0,  //...@.....+@+....+@+.....@
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0x01,0x9e,0xfe,0x70,0x00,0x07,0xdf,0xfc,0x70,0x9d,0xff,0xe9,0x00,  //.+%#@#*....*#@@#*.%#@@#%.


/* 西 */
0x0a,0xff,0xff,0xff,0xff,0xff,0xff,0xff,0xff,0xff,0xff,0xfa,0x00,  //.%@@@@@@@@@@@@@@@@@@@@@%.
0xa9,0x00,0x00,0x00,0x00,0x00,0x00,0x00,0x00,0x00,0x00,0x09,0xa0,  //%%.....................%%
0xf1,0x00,0x00,0x00,0x00,0x00,0x00,0x00,0x00,0x00,0x00,0x01,0xf0,  //@+.....................+@
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0x00,0x3a,0xff,0xff,0xff,0xff,0xff,0xff,0xff,0xff,0xfb,0x40,0x00,  //..*%@@@@@@@@@@@@@@@@@%*..


};


static const lv_font_fmt_txt_glyph_dsc_t glyph_dsc[] = {
    {.bitmap_index = 0,	.adv_w = 27, .box_h = 26, .box_w = 26, .ofs_x = 1, .ofs_y = 1},/*(兰)*/
    {.bitmap_index = 338,	.adv_w = 27, .box_h = 26, .box_w = 26, .ofs_x = 1, .ofs_y = 1},/*(安)*/
    {.bitmap_index = 676,	.adv_w = 27, .box_h = 26, .box_w = 26, .ofs_x = 1, .ofs_y = 1},/*(州)*/
    {.bitmap_index = 1014,	.adv_w = 27, .box_h = 26, .box_w = 26, .ofs_x = 1, .ofs_y = 1},/*(西)*/
};


static const uint16_t unicode_list_1[] = {
    0x5170,	/*(兰)*/
    0x5b89,	/*(安)*/
    0x5dde,	/*(州)*/
    0x897f,	/*(西)*/
    0x0000,    /*End indicator*/
};


static const lv_font_fmt_txt_cmap_t cmaps[] = {
    {
        .range_start = 0x5170,
        .range_length = 0x3810,
        .type = LV_FONT_FMT_TXT_CMAP_SPARSE_TINY,
        .glyph_id_start = 0,
        .unicode_list = unicode_list_1,
        .glyph_id_ofs_list = NULL,
        .list_length = 4,
    }
};


static lv_font_fmt_txt_glyph_cache_t glyph_cache;


static lv_font_fmt_txt_dsc_t font_dsc = {
    .glyph_bitmap = glyph_bitmap,
    .glyph_dsc = glyph_dsc,
    .cmaps = cmaps,
    .cmap_num = 1,
    .bpp = 4,

    .kern_scale = 0,
    .kern_dsc = NULL,
    .kern_classes = 0,

    .cache = &glyph_cache,
};


static int binsearch(const uint16_t *sortedSeq, int seqLength, uint16_t keyData) {
    int low = 0, mid, high = seqLength - 1;
    while (low <= high) {
        mid = (low + high)>>1;//右移1位等于是/2，奇数，无论奇偶，有个值就行
        if (keyData < sortedSeq[mid]) {
            high = mid - 1;//是mid-1，因为mid已经比较过了
        }
        else if (keyData > sortedSeq[mid]) {
            low = mid + 1;
        }
        else {
            return mid;
        }
    }
    return -1;
}


/* ---- W25Q64 中字库数据的地址和大小 ---- */
static uint32_t my_font_SCH_16_flash_addr = 0;
static uint32_t my_font_SCH_16_flash_size = 0;


/**
 * @brief  检查字库是否已存在于 W25Q64 Flash 中
 *
 * 【教学】
 *   生产环境中，字库可以只烧录一次（通过串口工具）。
 *   每次启动时先检查是否已存在，避免重复写入，也能省去 MCU 内部 Flash 中
 *   存储 glyph_bitmap[] 的需求（烧录后可以从编译中移除 .c 字库文件）。
 *
 * @retval true  字库已存在，addr/size 已记录
 * @retval false 字库不存在，需要调用 my_font_SCH_16_init() 写入
 */
bool my_font_SCH_16_check_exists(void)
{
    if (W25Q64_GetFileAddr(0, &my_font_SCH_16_flash_addr, &my_font_SCH_16_flash_size) >= 0) {
        printf("[Font] 字库已存在于 W25Q64, addr=0x%X, size=%u 字节\r\n",
               (unsigned int)my_font_SCH_16_flash_addr,
               (unsigned int)my_font_SCH_16_flash_size);
        return true;
    }
    printf("[Font] 字库未烧录，需首次写入\r\n");
    return false;
}


/**
 * @brief  初始化字库 —— 将 glyph_bitmap[] 写入 W25Q64 Flash
 *
 * 【教学】
 *   编译时，glyph_bitmap[] 数组被链接器放入 MCU 内部 Flash。
 *   运行时，该函数将整个字模数组通过 W25Q64_FileWrite() 搬到外部 W25Q64。
 *   写入成功后记录 Flash 中的起始地址和大小，供后续读取使用。
 */
void my_font_SCH_16_init(void)
{
    int32_t ret = W25Q64_FileWrite(0, glyph_bitmap, sizeof(glyph_bitmap));
    if (ret >= 0) {
        W25Q64_GetFileAddr(0, &my_font_SCH_16_flash_addr, &my_font_SCH_16_flash_size);
        printf("[Font] 字库已写入 W25Q64, addr=0x%X, size=%u 字节\r\n",
               (unsigned int)my_font_SCH_16_flash_addr,
               (unsigned int)my_font_SCH_16_flash_size);
    } else {
        printf("[Font] 字库写入失败! ret=%d\r\n", (int)ret);
    }
}


/**
 * @brief  校验字库 —— 回读 W25Q64 中数据并与原始 glyph_bitmap[] 逐字节比对
 */
void my_font_SCH_16_verify(void)
{
    if (my_font_SCH_16_flash_addr == 0) {
        printf("[Font] 字库未写入，跳过校验\r\n");
        return;
    }

    uint8_t  flash_buf[256];
    uint32_t total = sizeof(glyph_bitmap);
    uint32_t off;

    for (off = 0; off < total; off += 256) {
        uint32_t chunk = (total - off > 256) ? 256 : (total - off);
        W25Q64_Read(my_font_SCH_16_flash_addr + off, flash_buf, chunk);
        if (memcmp(flash_buf, glyph_bitmap + off, chunk) != 0) {
            printf("[Font] 校验失败 @ offset=%u!\r\n", (unsigned int)off);
            return;
        }
    }
    printf("[Font] 校验通过 (共 %u 字节)\r\n", (unsigned int)total);
}


/**
 * @brief  LVGL 回调：从 W25Q64 Flash 中读取指定 Unicode 字形的位图数据
 *
 * 【教学】
 *   这是实现"外部字库"的关键函数。
 *   LVGL 每次需要渲染一个汉字时，会调用此函数获取该字的字模位图。
 *   与旧版 __user_font_get_bitmap() 的区别：
 *     - 旧版：直接从 MCU Flash 中的 glyph_bitmap[] 返回指针
 *     - 新版：通过 W25Q64_Read() 从外部 Flash 读取字模到静态缓冲区
 */
static const uint8_t * __user_font_get_bitmap_flash(const lv_font_t * font, uint32_t unicode_letter)
{
    lv_font_fmt_txt_dsc_t * fdsc = (lv_font_fmt_txt_dsc_t *) font->dsc;

    if (unicode_letter < fdsc->cmaps[0].range_start ||
        unicode_letter > fdsc->cmaps[0].range_start + fdsc->cmaps[0].range_length)
        return NULL;

    int i;
    if (unicode_letter == fdsc->cache->last_letter) {
        i = fdsc->cache->last_glyph_id;
    } else {
        i = binsearch(fdsc->cmaps[0].unicode_list, fdsc->cmaps[0].list_length, unicode_letter);
    }

    if (i != -1) {
        const lv_font_fmt_txt_glyph_dsc_t * gdsc = &fdsc->glyph_dsc[i];
        fdsc->cache->last_glyph_id = i;
        fdsc->cache->last_letter = unicode_letter;

        /* 计算该字形位图的大小（与 LVGL 内部 get_glyph_bitmap_size 一致） */
        uint32_t bytes_per_row = (gdsc->box_w * fdsc->bpp + 7) / 8;
        uint32_t bitmap_size   = bytes_per_row * gdsc->box_h;

        /* 从 W25Q64 读取字模到静态缓冲区 */
        static uint8_t bitmap_buf[512];  /* 16px/4bpp 最大约 338 字节，512 足够 */
        W25Q64_Read(my_font_SCH_16_flash_addr + gdsc->bitmap_index, bitmap_buf, bitmap_size);
        return bitmap_buf;
    }
    return NULL;
}


static bool __user_font_get_glyph_dsc(const lv_font_t * font, lv_font_glyph_dsc_t * dsc_out, uint32_t unicode_letter, uint32_t unicode_letter_next) {
    lv_font_fmt_txt_dsc_t * fdsc = (lv_font_fmt_txt_dsc_t *) font->dsc;

    if (unicode_letter < fdsc->cmaps[0].range_start ||
        unicode_letter > fdsc->cmaps[0].range_start + fdsc->cmaps[0].range_length)
        return false;

    int i;
    if( unicode_letter==fdsc->cache->last_letter ){
        i = fdsc->cache->last_glyph_id;
    }
    else{
        i = binsearch(fdsc->cmaps[0].unicode_list, fdsc->cmaps[0].list_length, unicode_letter);
    }
    if( i != -1 ) {
        const lv_font_fmt_txt_glyph_dsc_t * gdsc = &fdsc->glyph_dsc[i];
        fdsc->cache->last_glyph_id = i;
        fdsc->cache->last_letter = unicode_letter;
        dsc_out->adv_w = gdsc->adv_w;
        dsc_out->box_h = gdsc->box_h;
        dsc_out->box_w = gdsc->box_w;
        dsc_out->ofs_x = gdsc->ofs_x;
        dsc_out->ofs_y = gdsc->ofs_y;
        dsc_out->bpp   = fdsc->bpp;
        return true;
    }
    return false;
}


//华文彩云,Regular,16
//字模高度：28
//内部字体
//使用排序和二分查表
const lv_font_t my_font_SCH_16 = {
    .dsc = &font_dsc,
    .get_glyph_bitmap = __user_font_get_bitmap_flash,
    .get_glyph_dsc = __user_font_get_glyph_dsc,
    .line_height = 28,
    .base_line = 0,
};

